// SPDX-License-Identifier: (GPL-2.0 OR MIT)
/*
 * Copyright 2020 NXP
 */

#include "freescale/imx8mm-evkb.dts"
#include <dt-bindings/gpio/gpio.h>
#include <dt-bindings/leds/common.h>

/ {
        model = "i.MX8MM Jaguar INST board";

	// Regulators
	reg_vddext_3v3: regulator-vddext {
		compatible = "regulator-fixed";
		regulator-name = "VDDEXT_3V3";
		regulator-min-microvolt = <3300000>;
		regulator-max-microvolt = <3300000>;
	};
};

//&fec1 {
//	fsl,magic-packet;
//	phy-handle = <&ethphy0>;
//	phy-mode = "rgmii-id";
////	phy-supply = <&reg_ethphy>;
//	pinctrl-names = "default";
//	pinctrl-0 = <&pinctrl_fec1>;
//
//	mdio {
//		#address-cells = <1>;
//		#size-cells = <0>;
//
//		ethphy0: ethernet-phy@7 {
//			compatible = "ethernet-phy-ieee802.3-c22";
//			interrupt-parent = <&gpio1>;
//			interrupts = <10 IRQ_TYPE_LEVEL_LOW>;
////			micrel,led-mode = <0>;
//			reg = <7>;
//		};
//	};
//};
