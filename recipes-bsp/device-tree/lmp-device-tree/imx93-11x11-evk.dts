// SPDX-License-Identifier: (GPL-2.0+ OR MIT)
/*
 * Copyright 2022 NXP
 * Copyright 2024 Dynamic Devices Ltd
 */

/dts-v1/;

#include "freescale/imx93.dtsi"

/ {
	model = "NXP i.MX93 11x11 EVK board";
	compatible = "fsl,imx93-11x11-evk", "fsl,imx93";

	chosen {
		stdout-path = &lpuart1;
	};
};
