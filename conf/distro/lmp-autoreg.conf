## conf/distro/lmp-autoreg.conf
```bitbake
require conf/distro/lmp.conf

DISTRO = "lmp-autoreg"

# Auto register
DISTRO_FEATURES:append = " auto-register"
```

## conf/distro/lmp-dynamicdevices-base.conf
```bitbake
#
# Custom distribution based on the standard LMP distribution
# This allows us to extend with extra DISTRO features we need
# which can't be added elsewhere
#

require conf/distro/lmp-base.conf

DISTRO = "lmp-dynamicdevices-base"
DISTROOVERRIDES = "lmp:lmp-base:lmp-dynamicdevices-base"
DISTRO_NAME = "Linux-microPlatform Dynamic Devices (No Factory)"
##DISTRO_FEATURES_BACKFILL_CONSIDERED = "ldconfig"

## Don't allow zeroconf (avahi is viewed as a security risk)
DISTRO_FEATURES:remove = " zeroconf"

## PulseAudio support in host for sentai unit
DISTRO_FEATURES:append:imx8mm-jaguar-sentai = " pulseaudio"

## Improv protocol (BLE/Serial) onboarding for sentai unit
DISTRO_FEATURES:append:imx8mm-jaguar-sentai = " improv"

## Disable USB for inst board
DISTRO_FEATURES:remove:imx8mm-jaguar-inst = " usbhost usbgadget"

# Support commercial license as we need it for Sentai audio testing with sox which needs ffmpeg
LICENSE_FLAGS_ACCEPTED:append = " commercial"

# Enable reproducible builds by setting a fixed timestamp
# This ensures identical builds from identical source code
# Set to 2021-01-01 00:00:00 UTC (1609459200)
SOURCE_DATE_EPOCH ?= "1609459200"
```

## conf/distro/lmp-dynamicdevices-waydroid.conf
```bitbake
#
# Custom distribution based on the standard LMP distribution
# This allows us to extend with extra DISTRO features we need
# which can't be added elsewhere
#

require conf/distro/lmp.conf

DISTRO = "lmp-dynamicdevices"
DISTROOVERRIDES = "lmp:lmp-dynamicdevices"
DISTRO_NAME = "Linux-microPlatform Base (no ostree) Dynamic Devices Waydroid"
#DISTRO_FEATURES_BACKFILL_CONSIDERED = "ldconfig"

# Auto register devices
DISTRO_FEATURES:append = " auto-register"

# PulseAudio / Flutter support in host
DISTRO_FEATURES:append = " pulseaudio opengl wayland waydroid"

# Improv protocol (BLE/Serial) onboarding
DISTRO_FEATURES:append:imx8mm-jaguar-sentai = " improv"
```

## conf/distro/lmp-dynamicdevices.conf
```bitbake
#
# Custom distribution based on the standard LMP distribution
# This allows us to extend with extra DISTRO features we need
# which can't be added elsewhere
#

require conf/distro/lmp.conf

DISTRO = "lmp-dynamicdevices"
DISTROOVERRIDES = "lmp:lmp-dynamicdevices"
DISTRO_NAME = "Linux-microPlatform  Dynamic Devices"
#DISTRO_FEATURES_BACKFILL_CONSIDERED = "ldconfig"

# Don't allow zeroconf (avahi is viewed as a security risk)
DISTRO_FEATURES:remove = " zeroconf"

# Auto register devices
DISTRO_FEATURES:append = " auto-register"

# PulseAudio support in host for sentai unit
#DISTRO_FEATURES:append:imx8mm-jaguar-sentai = " pulseaudio"

# Improv protocol (BLE/Serial) onboarding for sentai unit
DISTRO_FEATURES:append:imx8mm-jaguar-sentai = " improv"

# Disable USB for INST board
DISTRO_FEATURES:remove:imx8mm-jaguar-inst = " usbhost usbgadget"

# Encrypt root directory
#DISTRO_FEATURES:append = " luks"

# Support commercial license as we need it for Sentai audio testing with sox which needs ffmpeg
LICENSE_FLAGS_ACCEPTED:append = " commercial"
```

## conf/layer.conf
```bitbake
# Layer configuration for meta-dynamicdevices
# Application and middleware layer for Dynamic Devices Edge Computing platforms

# Layer identification
BBFILE_COLLECTIONS += "meta-dynamicdevices"
BBFILE_PATTERN_meta-dynamicdevices := "^${LAYERDIR}/"
BBFILE_PRIORITY_meta-dynamicdevices = "11"

# Layer version information
LAYERVERSION_meta-dynamicdevices = "1"
LAYER_CONF_VERSION ?= "7"

# Layer description and maintainer
LAYERDESCRIPTION_meta-dynamicdevices = "Application and middleware layer for Dynamic Devices edge computing platforms"
LAYERMAINTAINER_meta-dynamicdevices = "Dynamic Devices <info@dynamicdevices.co.uk>"

# We might have a conf and classes directory, append to BBPATH
BBPATH .= ":${LAYERDIR}"

# We have a recipes directory, add to BBFILES
BBFILES += "${LAYERDIR}/recipes*/*/*.bb ${LAYERDIR}/recipes*/*/*.bbappend"

BBFILES_DYNAMIC += " \
  rust-bin-layer:${LAYERDIR}/bbappends/meta-rust-bin/*/*/*.bb rust-bin-layer:${LAYERDIR}/bbappends/meta-rust-bin/*/*/*.bbappend \
  meta-tensorflow:${LAYERDIR}/bbappends/meta-tensorflow/*/*/*.bbappend \
  nxp-zigbee-rcp:${LAYERDIR}/bbappends/meta-nxp-zigbee-rcp/*/*/*.bbappend \
"

LAYERDEPENDS_meta-dynamicdevices = "meta-lmp-base meta-dynamicdevices-bsp meta-dynamicdevices-distro"
LAYERSERIES_COMPAT_meta-dynamicdevices = "scarthgap kirkstone"

# If we're building LXC with Kirkstone llvm objcopy/strip fails (e.g. for Waydroid)
OBJCOPY:pn-lxc:toolchain-clang = "${HOST_PREFIX}objcopy"
STRIP:pn-lxc:toolchain-clang = "${HOST_PREFIX}strip"

# GStreamer forked recipes - Updated to 1.26.0.imx for Conversa v2.0 support
PREFERRED_VERSION_gstreamer1.0:mx8-nxp-bsp              ?= "1.26.0.imx"
PREFERRED_VERSION_gstreamer1.0-plugins-bad:mx8-nxp-bsp  ?= "1.26.0.imx"
PREFERRED_VERSION_gstreamer1.0-plugins-base:mx8-nxp-bsp ?= "1.26.0.imx"
PREFERRED_VERSION_gstreamer1.0-plugins-good:mx8-nxp-bsp ?= "1.26.0.imx"
PREFERRED_VERSION_gstreamer1.0:mx9-nxp-bsp              ?= "1.26.0.imx"
PREFERRED_VERSION_gstreamer1.0-plugins-bad:mx9-nxp-bsp  ?= "1.26.0.imx"
PREFERRED_VERSION_gstreamer1.0-plugins-base:mx9-nxp-bsp ?= "1.26.0.imx"
PREFERRED_VERSION_gstreamer1.0-plugins-good:mx9-nxp-bsp ?= "1.26.0.imx"

# GStreamer copied recipes
PREFERRED_VERSION_gst-devtools:mx8-nxp-bsp              ?= "1.24.0.imx"
PREFERRED_VERSION_gstreamer1.0-libav:mx8-nxp-bsp        ?= "1.24.0.imx"
PREFERRED_VERSION_gstreamer1.0-omx:mx8-nxp-bsp          ?= "1.24.0.imx"
PREFERRED_VERSION_gstreamer1.0-plugins-ugly:mx8-nxp-bsp ?= "1.26.0"
PREFERRED_VERSION_gstreamer1.0-python:mx8-nxp-bsp       ?= "1.24.0.imx"
PREFERRED_VERSION_gstreamer1.0-rtsp-server:mx8-nxp-bsp  ?= "1.24.0.imx"
PREFERRED_VERSION_gstreamer1.0-vaapi:mx8-nxp-bsp        ?= "1.24.0.imx"

# Meson 1.4.2 for GStreamer 1.26.0 compatibility (requires Meson >= 1.4)
PREFERRED_VERSION_meson ?= "1.4.2"
PREFERRED_VERSION_gst-devtools:mx9-nxp-bsp              ?= "1.24.0.imx"
PREFERRED_VERSION_gstreamer1.0-libav:mx9-nxp-bsp        ?= "1.24.0.imx"
PREFERRED_VERSION_gstreamer1.0-omx:mx9-nxp-bsp          ?= "1.24.0.imx"
PREFERRED_VERSION_gstreamer1.0-plugins-ugly:mx9-nxp-bsp ?= "1.26.0"
PREFERRED_VERSION_gstreamer1.0-python:mx9-nxp-bsp       ?= "1.24.0.imx"
PREFERRED_VERSION_gstreamer1.0-rtsp-server:mx9-nxp-bsp  ?= "1.24.0.imx"
PREFERRED_VERSION_gstreamer1.0-vaapi:mx9-nxp-bsp        ?= "1.24.0.imx"
```

## conf/machine/imx8mm-jaguar-handheld.conf
```bitbake
#@TYPE: Machine
#@NAME: Dynamic Devices i.MX 8M Mini Jaguar Handheld board with LPDDR4
#@SOC: i.MX8MM
#@DESCRIPTION: Machine configuration for Dynamic Devices i.MX 8M Mini Jaguar Handheld board with LPDDR4
#@MAINTAINER: Vanessa Maegima <ajlennon@dynamicdevices.co.uk>

MACHINEOVERRIDES =. "imx8mm-lpddr4-evk:"

require conf/machine/imx8mm-lpddr4-evk.conf

KMACHINE = "imx8mmevk"
KERNEL_MODULE_AUTOLOAD:imx8mm-jaguar-handheld = " i2c-dev "

# Fix imx-vpu-hantro build failure
TOOLCHAIN:pn-imx-vpu-hantro = "gcc"
TOOLCHAIN:pn-imx-vpu-hantro-daemon = "gcc"
```

## conf/machine/imx8mm-jaguar-inst.conf
```bitbake
#@TYPE: Machine
#@NAME: Dynamic Devices i.MX 8M Mini Jaguar INST board with LPDDR4
#@SOC: i.MX8MM
#@DESCRIPTION: Machine configuration for Dynamic Devices i.MX 8M Mini Jaguar INST board with LPDDR4
#@MAINTAINER: Alex J Lennon  <ajlennon@dynamicdevices.co.uk>

MACHINEOVERRIDES =. "imx8mm-lpddr4-evk:"

require conf/machine/imx8mm-lpddr4-evk.conf

KMACHINE = "imx8mmevk"
KERNEL_MODULE_AUTOLOAD:imx8mm-jaguar-inst = " i2c-dev spidev"

MACHINE_FEATURES:remove:imx8mm-jaguar-inst = " nxp8987-sdio"

# Need to remove nxpiw612 to build SDK as for some reason it errors with a conflict with linux-firmware
MACHINE_FEATURES:append:imx8mm-jaguar-inst = " ax210"

# Conflicts with firmware-imx
PACKAGE_EXCLUDE = "linux-firmware-iwlwifi-misc"

# NOTE: This is *not* used for the lmp DISTRO / CI. This is just included for local development with lmp-base
KERNEL_DEVICETREE:append:imx8mm-jaguar-inst = " imx8mm-jaguar-inst.dtb"

# Fix imx-vpu-hantro build failure
TOOLCHAIN:pn-imx-vpu-hantro = "gcc"
TOOLCHAIN:pn-imx-vpu-hantro-daemon = "gcc"

# Need to have a non-default SPI buffer
KERNEL_MODULE_PROBECONF:append:imx8mm-jaguar-inst = "spidev"
module_conf_spidev = "options spidev bufsiz=16384"

# Secure boot SE050 into OpTee
MACHINE_FEATURES:append:imx8mm-jaguar-inst = " se05x"
# TODO: This line doesn't appear to take effect so overriding it in the OpTee recipe for now
SE05X_OEFID:imx8mm-jaguar-inst = "0xA200"
```

## conf/machine/imx8mm-jaguar-phasora.conf
```bitbake
#@TYPE: Machine
#@NAME: Dynamic Devices i.MX 8M Mini Jaguar Phasora board with LPDDR4
#@SOC: i.MX8MM
#@DESCRIPTION: Machine configuration for Dynamic Devices i.MX 8M Mini Jaguar Phasora board with LPDDR4
#@MAINTAINER: Alex J Lennon <ajlennon@dynamicdevices.co.uk>

MACHINEOVERRIDES =. "imx8mm-lpddr4-evk:"

require conf/machine/imx8mm-lpddr4-evk.conf

KMACHINE = "imx8mmevk"
KERNEL_MODULE_AUTOLOAD:imx8mm-jaguar-phasora = " i2c-dev leds-lp50xx spidev"

MACHINE_FEATURES:remove:imx8mm-jaguar-phasora = " nxp8987-sdio"

# Need to remove nxpiw612 to build SDK as for some reason it errors with a conflict with linux-firmware
MACHINE_FEATURES:append:imx8mm-jaguar-phasora = " ax210 tas2781 bgt60"

#SKIP_RECIPE[linux-firmware] = "linux-firmware is blacklisted"

# NOTE: This is *not* used for the lmp DISTRO / CI. This is just included for local development with lmp-base
KERNEL_DEVICETREE:append:imx8mm-jaguar-phasora = " imx8mm-jaguar-phasora.dtb"

# Fix imx-vpu-hantro build failure
TOOLCHAIN:pn-imx-vpu-hantro = "gcc"
TOOLCHAIN:pn-imx-vpu-hantro-daemon = "gcc"

# Need to have a non-default SPI buffer
KERNEL_MODULE_PROBECONF:append:imx8mm-jaguar-phasora = "spidev"
module_conf_spidev = "options spidev bufsiz=16384"
```

## conf/machine/imx8mm-jaguar-sentai.conf
```bitbake
#@TYPE: Machine
#@NAME: Dynamic Devices i.MX 8M Mini Jaguar Sentai board with LPDDR4
#@SOC: i.MX8MM
#@DESCRIPTION: Machine configuration for Dynamic Devices i.MX 8M Mini Jaguar Sentai board with LPDDR4
#@MAINTAINER: Alex J Lennon  <ajlennon@dynamicdevices.co.uk>

MACHINEOVERRIDES =. "imx8mm-lpddr4-evk:"

require conf/machine/imx8mm-lpddr4-evk.conf

KMACHINE = "imx8mmevk"
KERNEL_MODULE_AUTOLOAD:imx8mm-jaguar-sentai = " i2c-dev leds-lp50xx spidev snd-aloop"

MACHINE_FEATURES:remove:imx8mm-jaguar-sentai = " nxp8987-sdio"

# Need to remove nxpiw612 to build SDK as for some reason it errors with a conflict with linux-firmware
MACHINE_FEATURES:append:imx8mm-jaguar-sentai = " nxpiw612-sdio bgt60 stusb4500 zigbee"
#MACHINE_FEATURES:append:imx8mm-jaguar-sentai = " tas2781 bgt60"
#MACHINE_FEATURES:remove:imx8mm-jaguar-sentai = " nxpiw612-sdio"

#SKIP_RECIPE[linux-firmware] = "linux-firmware is blacklisted"

# NOTE: This is *not* used for the lmp DISTRO / CI. This is just included for local development with lmp-base
KERNEL_DEVICETREE:append:imx8mm-jaguar-sentai = " freescale/imx8mm-evkb.dtb"

# Fix imx-vpu-hantro build failure
TOOLCHAIN:pn-imx-vpu-hantro = "gcc"
TOOLCHAIN:pn-imx-vpu-hantro-daemon = "gcc"

# Fix nxp-afe* build failure
TOOLCHAIN:pn-nxp-afe = "gcc"
TOOLCHAIN:pn-nxp-afe-voiceseeker = "gcc"

# Need to have a non-default SPI buffer
KERNEL_MODULE_PROBECONF:append:imx8mm-jaguar-sentai = "spidev"
module_conf_spidev = "options spidev bufsiz=16384"

# Secure boot SE050 into OpTee
MACHINE_FEATURES:append:imx8mm-jaguar-sentai = " se05x"
# TODO: This line doesn't appear to take effect so overriding it in the OpTee recipe for now
SE05X_OEFID:imx8mm-jaguar-sentai = "0xA200"

SERIAL_CONSOLES = "115200:ttyUSBConsole"
```

## conf/machine/imx93-jaguar-eink.conf
```bitbake
#@TYPE: Machine
#@NAME: Dynamic Devices i.MX93 Jaguar E-Ink board with LPDDR4X
#@SOC: i.MX8MM
#@DESCRIPTION: Machine configuration for Dynamic Devices i.MX93 Jaguar E-Ink board with LPDDR4
#@MAINTAINER: Alex J Lennon  <ajlennon@dynamicdevices.co.uk>

MACHINEOVERRIDES =. "imx93-11x11-lpddr4x-evk:"

require conf/machine/imx93-11x11-lpddr4x-evk.conf

KMACHINE = "imx93-11x11-lpddr4x-evk"

MACHINE_FEATURES:remove:imx93-jaguar-eink = " nxp8987-sdio"

# IW612 chipset support for ublox MAYA W2 module (WiFi/BT/802.15.4)
MACHINE_FEATURES:append:imx93-jaguar-eink = " nxpiw612-sdio wifi bluetooth"

#SKIP_RECIPE[linux-firmware] = "linux-firmware is blacklisted"

# NOTE: This is *not* used for the lmp DISTRO / CI. This is just included for local development with lmp-base
KERNEL_DEVICETREE:append:imx93-jaguar-eink = " imx93-jaguar-eink.dtb"

# Fix imx-vpu-hantro build failure
TOOLCHAIN:pn-imx-vpu-hantro = "gcc"
TOOLCHAIN:pn-imx-vpu-hantro-daemon = "gcc"

# Fix nxp-afe* build failure
TOOLCHAIN:pn-nxp-afe = "gcc"
TOOLCHAIN:pn-nxp-afe-voiceseeker = "gcc"

# Need to have a non-default SPI buffer for optimal SPI communication
KERNEL_MODULE_PROBECONF:append:imx93-jaguar-eink = "spidev moal"
module_conf_spidev = "options spidev bufsiz=16384"
module_conf_moal = "options moal drvdbg=0"

# E-ink board specific: Remove audio/camera features, focus on wireless connectivity
MACHINE_FEATURES:remove:imx93-jaguar-eink = " alsa"

SERIAL_CONSOLES = "115200:ttyUSBConsole"

# === Fast Boot Optimizations ===
# Optimize kernel command line for fastest boot
OSTREE_KERNEL_ARGS:imx93-jaguar-eink ?= "console=ttyLP0,115200 rootfstype=ext4 quiet loglevel=3 rw rootwait"

# Load essential modules including wireless connectivity
KERNEL_MODULE_AUTOLOAD:imx93-jaguar-eink = " i2c-dev spidev bluetooth mlan moal"

# Boot time optimizations
OSTREE_BOOTLOADER_EXTRA_CONFIG:imx93-jaguar-eink = "bootdelay=1"
```

## conf/machine/include/lmp-factory-custom.inc
```bitbake
# LMP factory specific customizations (either replace or extend options as defined by meta-lmp)

# kernel modules signing key
MODSIGN_KEY_DIR = "${TOPDIR}/conf/factory-keys"
MODSIGN_PRIVKEY = "${MODSIGN_KEY_DIR}/privkey_modsign.pem"
MODSIGN_X509 = "${MODSIGN_KEY_DIR}/x509_modsign.crt"

# U-Boot signing key
UBOOT_SIGN_KEYDIR = "${TOPDIR}/conf/factory-keys"
UBOOT_SIGN_KEYNAME = "ubootdev"

# OP-TEE: Custom TA signing key
OPTEE_TA_SIGN_KEY = "${TOPDIR}/conf/factory-keys/opteedev.key"

# SPL / U-Boot proper signing key
UBOOT_SPL_SIGN_KEYDIR = "${TOPDIR}/conf/factory-keys"
UBOOT_SPL_SIGN_KEYNAME = "spldev"

# UEFI keys and certificates
UEFI_SIGN_KEYDIR = "${TOPDIR}/conf/factory-keys/uefi"

# TF-A Trusted Boot
TF_A_SIGN_KEY_PATH = "${TOPDIR}/conf/factory-keys/tf-a/privkey_ec_prime256v1.pem"

# Use custom DTS handling
PREFERRED_PROVIDER_virtual/dtb ?= "lmp-device-tree"

PACKAGECONFIG:append:pn-networkmanager:imx8mm-jaguar-sentai = " modemmanager ppp"

# Support SE050
SE05X_OEFID:imx8mm-jaguar-sentai = "0xA1F4"
MACHINE_FEATURES:append:imx8mm-jaguar-sentai = " se05x"

SE05X_OEFID:imx8mm-jaguar-inst = "0xA1F4"
MACHINE_FEATURES:append:imx8mm-jaguar-inst = " se05x"
```
